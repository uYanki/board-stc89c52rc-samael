#include "lib_lcd1602.h"

void delay_ms(uint16_t ms) {
    uint16_t i, j;
    for (i = ms; i > 0; i--)
        for (j = 110; j > 0; j--)
            ;
}

// 自定义字模
uint8_t chars_custom[8][8] =                            //
    {{0x00, 0x04, 0x0E, 0x15, 0x11, 0x11, 0x0E, 0x00},  //
     {0x00, 0x1E, 0x0B, 0x0B, 0x0B, 0x0B, 0x16, 0x00},  //
     {0x00, 0x00, 0x00, 0x00, 0x1F, 0x00, 0x1F, 0x00},  //
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     {0x00, 0x1E, 0x0B, 0x0B, 0x0B, 0x0B, 0x16, 0x00}};

void main() {
    uint8_t i;

#define N 8

    LCD1602_Init();

    // LCD1602_WriteCmd(LCD1602_DISPLAY_OFF);

    LCD1602_WriteCGRAMs(&chars_custom, N);  // 写字库
    LCD1602_SetCursor(0, 0);
    for (i = 0; i < N; ++i) { LCD1602_WriteData(i); }  // 显示自己的字模

    LCD1602_ShowStrEx(0, 13, "WOSHIUYK");

    while (1) {
        delay_ms(800);
        LCD1602_WriteCmd(LCD1602_LEFT_MOVE);
    }
}
